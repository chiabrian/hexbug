/**
 * @cliArgs --device "MSPM0L130X" --part "Default" --package "VSSOP-20(DGS20)" --product "mspm0_sdk@2.10.00.04"
 * @versions {"tool":"1.26.2+4477"}
 */

/**
 * Import the modules used in this configuration.
 */
const ADC12   = scripting.addModule("/ti/driverlib/ADC12", {}, false);
const ADC121  = ADC12.addInstance();
const GPIO    = scripting.addModule("/ti/driverlib/GPIO", {}, false);
const GPIO1   = GPIO.addInstance();
const GPIO2   = GPIO.addInstance();
const GPIO3   = GPIO.addInstance();
const GPIO4   = GPIO.addInstance();
const GPIO5   = GPIO.addInstance();
const GPIO6   = GPIO.addInstance();
const GPIO7   = GPIO.addInstance();
const GPIO8   = GPIO.addInstance();
const GPIO9   = GPIO.addInstance();
const GPIO10  = GPIO.addInstance();
const GPIO11  = GPIO.addInstance();
const PWM     = scripting.addModule("/ti/driverlib/PWM", {}, false);
const PWM1    = PWM.addInstance();
const PWM2    = PWM.addInstance();
const SYSCTL  = scripting.addModule("/ti/driverlib/SYSCTL");
const SYSTICK = scripting.addModule("/ti/driverlib/SYSTICK");
const TIMER   = scripting.addModule("/ti/driverlib/TIMER", {}, false);
const TIMER1  = TIMER.addInstance();

/**
 * Write custom configuration values to the imported modules.
 */
ADC121.$name          = "ADC12_0";
ADC121.adcMem0chansel = "DL_ADC12_INPUT_CHAN_15";
ADC121.sampClkDiv     = "DL_ADC12_CLOCK_DIVIDE_4";

const Board = scripting.addModule("/ti/driverlib/Board", {}, false);

GPIO1.port                               = "PORTA";
GPIO1.portSegment                        = "Lower";
GPIO1.$name                              = "SW1";
GPIO1.associatedPins[0].assignedPin      = "4";
GPIO1.associatedPins[0].direction        = "INPUT";
GPIO1.associatedPins[0].internalResistor = "PULL_UP";
GPIO1.associatedPins[0].$name            = "TRIG_RIGHT";

GPIO2.$name                              = "SW2";
GPIO2.associatedPins[0].assignedPort     = "PORTA";
GPIO2.associatedPins[0].assignedPin      = "6";
GPIO2.associatedPins[0].direction        = "INPUT";
GPIO2.associatedPins[0].internalResistor = "PULL_UP";
GPIO2.associatedPins[0].$name            = "TRIG_LEFT";

GPIO3.$name                              = "SW4";
GPIO3.associatedPins[0].assignedPort     = "PORTA";
GPIO3.associatedPins[0].direction        = "INPUT";
GPIO3.associatedPins[0].internalResistor = "PULL_UP";
GPIO3.associatedPins[0].assignedPin      = "17";
GPIO3.associatedPins[0].$name            = "UP";

GPIO4.$name                              = "SW3";
GPIO4.associatedPins[0].assignedPort     = "PORTA";
GPIO4.associatedPins[0].direction        = "INPUT";
GPIO4.associatedPins[0].internalResistor = "PULL_UP";
GPIO4.associatedPins[0].assignedPin      = "22";
GPIO4.associatedPins[0].$name            = "DOWN";

GPIO5.$name                              = "SW5";
GPIO5.associatedPins[0].assignedPort     = "PORTA";
GPIO5.associatedPins[0].direction        = "INPUT";
GPIO5.associatedPins[0].internalResistor = "PULL_UP";
GPIO5.associatedPins[0].assignedPin      = "27";
GPIO5.associatedPins[0].$name            = "LEFT";

GPIO6.$name                              = "SW6";
GPIO6.associatedPins[0].assignedPort     = "PORTA";
GPIO6.associatedPins[0].direction        = "INPUT";
GPIO6.associatedPins[0].internalResistor = "PULL_UP";
GPIO6.associatedPins[0].assignedPin      = "26";
GPIO6.associatedPins[0].$name            = "RIGHT";

GPIO7.$name                              = "CH1";
GPIO7.associatedPins[0].assignedPort     = "PORTA";
GPIO7.associatedPins[0].direction        = "INPUT";
GPIO7.associatedPins[0].internalResistor = "PULL_UP";
GPIO7.associatedPins[0].assignedPin      = "18";
GPIO7.associatedPins[0].$name            = "SW7_1";

GPIO8.$name                              = "CH2";
GPIO8.associatedPins[0].assignedPort     = "PORTA";
GPIO8.associatedPins[0].direction        = "INPUT";
GPIO8.associatedPins[0].internalResistor = "PULL_UP";
GPIO8.associatedPins[0].assignedPin      = "25";
GPIO8.associatedPins[0].$name            = "SW7_2";

GPIO9.$name                              = "CH3";
GPIO9.associatedPins[0].assignedPort     = "PORTA";
GPIO9.associatedPins[0].direction        = "INPUT";
GPIO9.associatedPins[0].internalResistor = "PULL_UP";
GPIO9.associatedPins[0].assignedPin      = "24";
GPIO9.associatedPins[0].$name            = "SW7_3";

GPIO10.$name                              = "CH4";
GPIO10.associatedPins[0].assignedPort     = "PORTA";
GPIO10.associatedPins[0].direction        = "INPUT";
GPIO10.associatedPins[0].internalResistor = "PULL_UP";
GPIO10.associatedPins[0].assignedPin      = "23";
GPIO10.associatedPins[0].$name            = "SW7_4";

GPIO11.$name                         = "LED_G";
GPIO11.port                          = "PORTA";
GPIO11.associatedPins[0].$name       = "PIN_1";
GPIO11.associatedPins[0].assignedPin = "16";

PWM1.$name                   = "PWM_0";
PWM1.clockPrescale           = 32;
PWM1.pwmMode                 = "EDGE_ALIGN_UP";
PWM1.ccIndex                 = [1];
PWM1.ccp1PinConfig.$name     = "ti_driverlib_gpio_GPIOPinGeneric2";
PWM1.peripheral.$assign      = "TIMG4";
PWM1.PWM_CHANNEL_1.$name     = "ti_driverlib_pwm_PWMTimerCC0";
PWM1.PWM_CHANNEL_1.dutyCycle = 50;

PWM2.$name                              = "PWM_IR";
PWM2.clockDivider                       = 4;
PWM2.timerCount                         = 216;
PWM2.ccIndex                            = [0];
PWM2.PWM_CHANNEL_0.$name                = "ti_driverlib_pwm_PWMTimerCC1";
PWM2.PWM_CHANNEL_0.dutyCycle            = 50;
PWM2.ccp0PinConfig.direction            = scripting.forceWrite("OUTPUT");
PWM2.ccp0PinConfig.hideOutputInversion  = scripting.forceWrite(false);
PWM2.ccp0PinConfig.onlyInternalResistor = scripting.forceWrite(false);
PWM2.ccp0PinConfig.passedPeripheralType = scripting.forceWrite("Digital");
PWM2.ccp0PinConfig.$name                = "ti_driverlib_gpio_GPIOPinGeneric1";
PWM2.peripheral.ccp0Pin.$assign         = "PA0";


SYSTICK.periodEnable    = true;
SYSTICK.period          = 32000;
SYSTICK.interruptEnable = true;
SYSTICK.systickEnable   = true;

TIMER1.$name            = "TIMER_0";
TIMER1.timerClkPrescale = 32;
TIMER1.timerPeriod      = ".00174";

const ProjectConfig              = scripting.addModule("/ti/project_config/ProjectConfig", {}, false);
ProjectConfig.migrationCondition = true;

/**
 * Pinmux solution for unlocked pins/peripherals. This ensures that minor changes to the automatic solver in a future
 * version of the tool will not impact the pinmux you originally saw.  These lines can be completely deleted in order to
 * re-solve from scratch.
 */
ADC121.peripheral.$suggestSolution            = "ADC0";
Board.peripheral.$suggestSolution             = "DEBUGSS";
Board.peripheral.swclkPin.$suggestSolution    = "PA20";
Board.peripheral.swdioPin.$suggestSolution    = "PA19";
GPIO1.associatedPins[0].pin.$suggestSolution  = "PA4";
GPIO2.associatedPins[0].pin.$suggestSolution  = "PA6";
GPIO3.associatedPins[0].pin.$suggestSolution  = "PA17/OPA1.IN0-";
GPIO4.associatedPins[0].pin.$suggestSolution  = "PA22";
GPIO5.associatedPins[0].pin.$suggestSolution  = "PA27";
GPIO6.associatedPins[0].pin.$suggestSolution  = "PA26";
GPIO7.associatedPins[0].pin.$suggestSolution  = "PA18";
GPIO8.associatedPins[0].pin.$suggestSolution  = "PA25";
GPIO9.associatedPins[0].pin.$suggestSolution  = "PA24/OPA0.IN0-";
GPIO10.associatedPins[0].pin.$suggestSolution = "PA23";
GPIO11.associatedPins[0].pin.$suggestSolution = "PA16";
PWM1.peripheral.ccp1Pin.$suggestSolution      = "PA11";
PWM2.peripheral.$suggestSolution              = "TIMG1";
SYSCTL.peripheral.$suggestSolution            = "SYSCTL";
TIMER1.peripheral.$suggestSolution            = "TIMG0";
